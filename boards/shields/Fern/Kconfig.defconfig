## boards/shields/Fern/Kconfig.defconfig
```kconfig
# Copyright (c) 2024 The ZMK Contributors
# SPDX-License-Identifier: MIT

if SHIELD_FERN_FERN_DONGLE

config ZMK_KEYBOARD_NAME
    default "Fern"

config ZMK_SPLIT_BLE_CENTRAL_BATTERY_LEVEL_FETCHING
    default y

config ZMK_DISPLAY
   default y
    
config ZMK_SPLIT_ROLE_CENTRAL
    default y

config ZMK_USB
    default y

endif # SHIELD_FERN_FERN_DONGLE

if SHIELD_FERN_LEFT || SHIELD_FERN_RIGHT || SHIELD_FERN_DONGLE

config ZMK_SPLIT
    default y

config ZMK_BLE
    default y

endif
```

## config/board/shields/Fern/Kconfig.defconfig
```kconfig
if SHIELD_Fern_left

config ZMK_KEYBOARD_NAME
    default "Fern"
    
config ZMK_SPLIT_ROLE_CENTRAL
    default y

endif

if SHIELD_Fern_left || SHIELD_Fern_right

config ZMK_SPLIT
    default y

endif
```

## config/board/shields/Fern/Kconfig.shield
```kconfig
config SHIELD_FERN_LEFT
    def_bool $(shields_list_contains,Fern_left)

config SHIELD_FERN_RIGHT
    def_bool $(shields_list_contains,Fern_right)
```
