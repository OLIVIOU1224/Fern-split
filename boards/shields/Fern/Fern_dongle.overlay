#include "Fern.dtsi"

/ {
    chosen {
        zmk,kscan = &mock_kscan0;
        zmk,matrix_transform = &default_transform;
    };

    mock_kscan0: kscan {
        compatible = "zmk,kscan-mock";
        columns = <10>;
        rows = <4>;
        events = <0>;
    };
};

&kscan0 {
    status = "disabled";
};
